 / {
    behaviors {
        animls: animls {
            compatible = "zmk,behavior-animation-layer-status";
            #binding-cells = <2>;
        };
    };

    animation_layer_status: animation_layer_status {
        compatible = "zmk,animation-layer-status";
        status = "okay";

        // デフォルトカラー（青）
        default-color = <0x0000FF>;

        // ピクセル番号
        pixels = <0 1 2 3>;

        // 各レイヤー色を RGB整数で指定（0xRRGGBB）
        colors = <
            0x00B8E6   // Layer 0: Cyan
            0xFF0000   // Layer 1: Red
            0xFFFFFF   // Layer 2: White
            0xFF8000   // Layer 3: Orange
        >;
    };
};